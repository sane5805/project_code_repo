## base_external/Config.in
```kconfig
source "$BR2_EXTERNAL_assignment_base_PATH/package/aesd-assignments/Config.in"
source "$BR2_EXTERNAL_assignment_base_PATH/package/socket-communication/Config.in"
```

## base_external/package/socket-communication/Config.in
```kconfig
config BR2_PACKAGE_SOCKET_COMMUNICATION
	bool "server-socket"
	help
	  Includes the server side code for socket communication.
```

## base_external/package/temp-sensor/Config.in
```kconfig
config BR2_PACKAGE_SOCKET_COMMUNICATION
	bool "temp-sensor"
	help
	    Includes the temperature sensor code
```
